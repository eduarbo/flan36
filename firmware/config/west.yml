## firmware/config/west.yml
```yaml
manifest:
  remotes:
    - name: zmkfirmware
      url-base: https://github.com/zmkfirmware
  projects:
    - name: zmk
      remote: zmkfirmware
      revision: edf5c0814fd3ea202e43aad2d68fd32e882a518c
      import: app/west.yml
  self:
    path: config
```
