## firmware/config/boards/shields/flan36/Kconfig.defconfig
```kconfig
if SHIELD_FLAN36_LEFT
config ZMK_KEYBOARD_NAME
 default "Flan36"
config ZMK_SPLIT_ROLE_CENTRAL
 default y
endif
if SHIELD_FLAN36_LEFT || SHIELD_FLAN36_RIGHT
config ZMK_SPLIT
 default y
endif
```

## firmware/config/boards/shields/flan36/Kconfig.shield
```kconfig
config SHIELD_FLAN36_LEFT
 def_bool $(shields_list_contains,flan36_left)
config SHIELD_FLAN36_RIGHT
 def_bool $(shields_list_contains,flan36_right)
```
