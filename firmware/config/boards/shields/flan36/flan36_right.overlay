#include "flan36.dtsi"
#include "flan36-display.dtsi"
&default_transform { col-offset = <6>; };

// Right-hand MCU pins exit toward the key field, preserving the slim aperture.
&kscan0 {
 row-gpios = <&pro_micro 21 (GPIO_ACTIVE_HIGH | GPIO_PULL_DOWN)>, <&pro_micro 20 (GPIO_ACTIVE_HIGH | GPIO_PULL_DOWN)>, <&pro_micro 19 (GPIO_ACTIVE_HIGH | GPIO_PULL_DOWN)>, <&pro_micro 18 (GPIO_ACTIVE_HIGH | GPIO_PULL_DOWN)>;
 col-gpios = <&pro_micro 15 GPIO_ACTIVE_HIGH>, <&pro_micro 7 GPIO_ACTIVE_HIGH>, <&pro_micro 8 GPIO_ACTIVE_HIGH>, <&pro_micro 9 GPIO_ACTIVE_HIGH>, <&pro_micro 10 GPIO_ACTIVE_HIGH>, <&pro_micro 16 GPIO_ACTIVE_HIGH>;
};
